## boards/arm/tsuru_stm/Kconfig.board
```kconfig
# Le Chiffre (stm32) board configuration

# Copyright (c) 2020 The ZMK Contributors
# SPDX-License-Identifier: MIT

config BOARD_TSURU_STM
    bool "Tsuru (stm)"
    depends on SOC_STM32F072XB
```

## boards/arm/tsuru_stm/Kconfig.defconfig
```kconfig
# Vault katana (stm32) board configuration

# Copyright (c) 2020 The ZMK Contributors
# SPDX-License-Identifier: MIT

if BOARD_TSURU_STM

config BOARD
    default "tsuru_stm"

config ZMK_KEYBOARD_NAME
    default "Tsuru STM"

config ZMK_USB
    default y

config ZMK_KSCAN_MATRIX_POLLING
    default y

endif # BOARD_LE_CHIFFRE_STM32
```
